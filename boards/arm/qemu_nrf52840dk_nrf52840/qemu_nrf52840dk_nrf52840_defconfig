## boards/arm/qemu_nrf52840dk_nrf52840/qemu_nrf52840dk_nrf52840_defconfig
```kconfig
# SPDX-License-Identifier: Apache-2.0

CONFIG_SOC_SERIES_NRF52X=y
CONFIG_SOC_NRF52840_QIAA=y
CONFIG_BOARD_NRF52840DK_NRF52840=y

# Enable MPU
CONFIG_ARM_MPU=y

# Disable DWT
CONFIG_NULL_POINTER_EXCEPTION_DETECTION_NONE=y 
CONFIG_CORTEX_M_DWT=n

# Enable hardware stack protection
CONFIG_HW_STACK_PROTECTION=y

# Enable RTT
CONFIG_USE_SEGGER_RTT=y

# enable GPIO
CONFIG_GPIO=y

# enable uart driver
CONFIG_SERIAL=y

# enable console
CONFIG_CONSOLE=y
CONFIG_UART_CONSOLE=y

# additional board options
CONFIG_GPIO_AS_PINRESET=y

#CONFIG_CORTEX_M_SYSTICK=y
#CONFIG_RUNTIME_NMI=y
#CONFIG_QEMU_ICOUNT=y
#CONFIG_QEMU_ICOUNT_SHIFT=7
```

## tests/multi_build/testcase.yaml
```yaml
tests:
  multi_build.multi_build:
    sysbuild: true
    tags:
      - 'multi_build'
    build_only: true
```

## tests/sharing_builds/peripheral_hr/sample.yaml
```yaml
sample:
  name: Bluetooth Peripheral HR
  description: Demonstrates the HR (Heart Rate) GATT Service
tests:
  sample.bluetooth.peripheral_hr:
    harness: bluetooth
    platform_allow:
      - qemu_cortex_m3
      - qemu_x86
    integration_platforms:
      - qemu_cortex_m3
    tags: bluetooth
```

## tests/sharing_builds/testcase.yaml
```yaml
tests:
  bluetooth.central_and_peripheral:
    required_images:
      - sample.bluetooth.central
      - sample.bluetooth.peripheral_hr
    platform_allow:
      - qemu_cortex_m3
    harness: pytest
    tags: bluetooth
```
